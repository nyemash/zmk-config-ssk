## config/boards/shields/ssk/Kconfig.defconfig
```kconfig
if SHIELD_SSK

config ZMK_KEYBOARD_NAME
    default "SSKoy"

config SPI
    default y
    
# enable pinctrl
CONFIG_PINCTRL=y

# enable GPIO
CONFIG_GPIO=y

endif
```
